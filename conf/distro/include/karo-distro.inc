## conf/distro/include/karo-distro.inc
```bitbake
POKY_DISTRO ??= "poky"
require conf/distro/${POKY_DISTRO}.conf

POKY_DEFAULT_DISTRO_FEATURES_remove = " \
                                       largefile \
                                       opengl \
                                       ptest \
                                       vulkan \
                                       wayland \
"

DISTRO_FEATURES_DEFAULT_remove = " \
                                  3g \
                                  argp \
                                  bluetooth \
                                  nfc \
                                  pcmcia \
                                  wifi \
                                  x11 \
                                  zeroconf \
"

DISTRO_FEATURES_append = " \
                          alternatives-symlinks-relative \
                          dhcpcd \
                          ldconfig \
                          pam \
                          telnet-login \
"

DISTRO_FEATURES_append_mx8  = " dsi83"
DISTRO_FEATURES_append_tx8m = " pcie"
DISTRO_FEATURES_append_qs8m = " csi-camera imx219 raspi-display tc358867"
DISTRO_FEATURES_append_qsxm = " basler csi-camera pcie raspi-display tc358867"
DISTRO_FEATURES_append_qsxp = " basler csi-camera pcie raspi-display tc358867"
DISTRO_FEATURES_append_tx8p = " lvds"

VIRTUAL-RUNTIME_base-utils-hwclock = "util-linux-hwclock"
VIRTUAL-RUNTIME_dev_manager ?= "udev"
VIRTUAL-RUNTIME_init_manager ?= "${@bb.utils.contains('DISTRO_FEATURES',"systemd","systemd","sysvinit",d)}"

PREFERRED_PROVIDER_opencl-headers = "imx-gpu-viv"

VOLATILE_LOG_DIR = "no"

# mask out sysvinit recipes from meta-imx layer
BBMASK += ".*/meta-imx/.*/sysvinit/.*"

# mask out bbappend from devil since it's fetch gives 404
BBMASK += ".*/meta-imx/meta-sdk/recipes-graphics/devil/devil_%.bbappend"

# mask out recipe breaking the weston desktop without systemd
BBMASK += ".*/meta-imx/meta-bsp/recipes-graphics/wayland/weston-init.bbappend"
```

## conf/distro/karo-base.conf
```bitbake
require conf/distro/include/karo-distro.inc

DISTRO = "karo-base"

DISTRO_NAME = "karo-base (Ka-Ro Linux BSP with basic VT support)"
DISTRO_VERSION = "5.4-${DISTRO_CODENAME}"

DISTRO_FEATURES_remove = "gobject-introspection-data pulseaudio"
DISTRO_FEATURES_BACKFILL_CONSIDERED += "gobject-introspection-data pulseaudio"
```

## conf/distro/karo-minimal.conf
```bitbake
require conf/distro/include/karo-distro.inc

DISTRO = "karo-minimal"
DISTRO_NAME = "karo-minimal (Ka-Ro Linux BSP with minimal read-only rootfs)"
DISTRO_VERSION = "5.10-${DISTRO_CODENAME}"

DISTRO_FEATURES_remove = " \
                          gobject-introspection-data \
                          multiarch \
                          opengl \
                          ptest \
                          pulseaudio \
                          vulkan \
                          wayland \
"

# kernelfeatures not needed in minimal
DISTRO_FEATURES_remove = " \
                          csi-camera \
                          imx219 \
"
```

## conf/distro/karo-xwayland.conf
```bitbake
require conf/distro/include/karo-distro.inc

DISTRO = "karo-xwayland"
DISTRO_NAME = "karo-wayland (Ka-Ro Linux BSP with xwayland backend)"
DISTRO_VERSION = "5.4-${DISTRO_CODENAME}"

# mask out .bbappends from karo-minimal distro
BBMASK += ".*/recipes-karo-minimal/.*"
# mask out gtk+3 bbappend from fsl since it removes gtk x11 support
BBMASK += "meta-freescale/recipes-graphics/gtk\+/gtk\+3_%.bbappend"

# add support for xwayland
DISTRO_FEATURES_append = " \
                          opengl \
                          vulkan \
                          wayland \
                          x11 \
                          pam \
"
```

## conf/layer.conf
```bitbake
# We have a conf and classes directory, add to BBPATH
BBPATH .= ":${LAYERDIR}"

# We have a packages directory, add to BBFILES
BBFILES += "${LAYERDIR}/recipes-*/*/*.bb \
            ${LAYERDIR}/recipes-*/*/*.bbappend \
            ${LAYERDIR}/recipes-*/*/*/*.bb \
            ${LAYERDIR}/recipes-*/*/*/*.bbappend \
"

BBFILE_COLLECTIONS += "karo-nxp-distro"
BBFILE_PATTERN_karo-nxp-distro := "^${LAYERDIR}/"
BBFILE_PRIORITY_karo-nxp-distro = "11"

LAYERDEPENDS_karo-nxp-distro = "karo-nxp"
LAYERSERIES_COMPAT_karo-nxp-distro = "hardknott"

FILESYSTEM_PERMS_TABLES = "meta/files/fs-perms.txt"
```
